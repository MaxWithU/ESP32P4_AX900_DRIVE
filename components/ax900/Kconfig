## components/ax900/Kconfig
```kconfig
menu "AX900 USB Wi-Fi"
config AX900_FAULT_INJECTION
    bool "Enable local serial fault injection diagnostics"
    default n
    help
        Enables controlled RX cancellation, link drop, and DHCP timeout tests.
        Disabled by default. Only for development firmware.
config AX900_ENCRYPTED_PROFILES
    bool "Require preprovisioned protected encrypted Wi-Fi storage"
    default n
    depends on NVS_ENCRYPTION
    help
        Requires flash encryption already enabled and a provisioned encrypted NVS
        keys partition. The driver never burns eFuses or generates keys. Failure
        leaves credential storage unavailable; there is no plaintext fallback.
config AX900_PROFILE_PARTITION
    string "NVS partition containing AX900 profiles"
    default "ax900_nvs" if AX900_ENCRYPTED_PROFILES
    default "nvs"
config AX900_PROFILE_KEYS_PARTITION
    string "Preprovisioned encrypted NVS keys partition"
    depends on AX900_ENCRYPTED_PROFILES
    default "nvs_keys"
endmenu
```

## sdkconfig.defaults
```kconfig
CONFIG_IDF_TARGET="esp32p4"
CONFIG_ESPTOOLPY_FLASHSIZE_16MB=y
CONFIG_ESP_CONSOLE_USB_SERIAL_JTAG=y
CONFIG_ESP_CONSOLE_SECONDARY_NONE=y
CONFIG_USB_HOST_HUBS_SUPPORTED=y
CONFIG_USB_HOST_ENABLE_ENUM_FILTER_CALLBACK=y
CONFIG_LOG_DEFAULT_LEVEL_INFO=y
CONFIG_ESP_MAIN_TASK_STACK_SIZE=12288

CONFIG_PARTITION_TABLE_SINGLE_APP_LARGE=y
CONFIG_ESP_NETIF_SET_DNS_PER_DEFAULT_NETIF=y
CONFIG_MBEDTLS_HAVE_TIME=y
CONFIG_MBEDTLS_HAVE_TIME_DATE=y
```
